/*
 * Copyright (c) 2024 The ZMK Contributors
 * SPDX-License-Identifier: MIT
 */

#include "charybdis_layers.h"
#include <dt-bindings/zmk/input_transform.h>
#include <input/processors.dtsi>

#define CHARYBDIS_TRACKBALL_PROCESSORS \
    scroll { \
        layers = <MEDIA NOSCROLL>; \
        input-processors = <&zip_xy_scaler 1 15>, <&zip_xy_to_scroll_mapper>, <&zip_scroll_scaler 1 3>, <&zip_scroll_transform (INPUT_TRANSFORM_Y_INVERT)>; \
    }; \
    \
    move { \
        layers = <BASE NAV NUM SYM KBD GAME GAME_NUM>; \
        input-processors = <&zip_xy_scaler 1 4>; \
    };
